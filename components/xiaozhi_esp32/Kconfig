## components/xiaozhi_esp32/Kconfig
```kconfig
menu "Xiaozhi Assistant"

config OTA_URL
    string "Default OTA URL"
    default "https://api.tenclass.net/xiaozhi/ota/"
    help
        The application will access this URL to check for new firmwares and server address.

choice
    prompt "Default Language"
    default LANGUAGE_ZH_CN
    help
        Select device display language

    config LANGUAGE_ZH_CN
        bool "Chinese"
endchoice

choice BOARD_TYPE
    prompt "Board Type"
    default BOARD_TYPE_SMART_PUPPY
    help
        Board type. 开发板类型
    config BOARD_TYPE_SMART_PUPPY
        bool "Bread Smart Puppy"
        depends on IDF_TARGET_ESP32S3
endchoice

choice WAKE_WORD_TYPE
    prompt "Wake Word Implementation Type"
    default USE_AFE_WAKE_WORD if (IDF_TARGET_ESP32S3 || IDF_TARGET_ESP32P4) && SPIRAM
    default WAKE_WORD_DISABLED
    help
        Choose the type of wake word implementation to use

    config WAKE_WORD_DISABLED
        bool "Disabled"
        help
            Disable wake word detection

    config USE_ESP_WAKE_WORD
        bool "Wakenet model without AFE"
        depends on IDF_TARGET_ESP32C3 || IDF_TARGET_ESP32C5 || IDF_TARGET_ESP32C6 || (IDF_TARGET_ESP32 && SPIRAM)
        help
            Support ESP32 C3、ESP32 C5 与 ESP32 C6, and (ESP32 with PSRAM)

    config USE_AFE_WAKE_WORD
        bool "Wakenet model with AFE"
        depends on (IDF_TARGET_ESP32S3 || IDF_TARGET_ESP32P4) && SPIRAM
        help
            Support AEC if available, requires ESP32 S3 and PSRAM

    config USE_CUSTOM_WAKE_WORD
        bool "Multinet model (Custom Wake Word)"
        depends on (IDF_TARGET_ESP32S3 || IDF_TARGET_ESP32P4) && SPIRAM
        help
            Requires ESP32 S3 and PSRAM

endchoice

config CUSTOM_WAKE_WORD
    string "Custom Wake Word"
    default "xiao tu dou"
    depends on USE_CUSTOM_WAKE_WORD
    help
        Custom Wake Word, use pinyin for Chinese, separated by spaces

config CUSTOM_WAKE_WORD_DISPLAY
    string "Custom Wake Word Display"
    default "小土豆"
    depends on USE_CUSTOM_WAKE_WORD
    help
        Greeting sent to the server after wake word detection

config CUSTOM_WAKE_WORD_THRESHOLD
    int "Custom Wake Word Threshold (%)"
    default 20
    range 1 99
    depends on USE_CUSTOM_WAKE_WORD
    help
        Custom Wake Word Threshold, range 1-99, the smaller the more sensitive, default 20

config SEND_WAKE_WORD_DATA
    bool "Send Wake Word Data"
    default y
    depends on USE_AFE_WAKE_WORD || USE_CUSTOM_WAKE_WORD
    help
        Send wake word data to the server as the first message of the conversation and wait for response

config WAKE_WORD_DETECTION_IN_LISTENING
    bool "Enable Wake Word Detection in Listening Mode"
    default n
    depends on USE_AFE_WAKE_WORD || USE_CUSTOM_WAKE_WORD
    help
        Enable wake word detection while in listening mode.
        When enabled, the device can detect wake word during listening,
        which allows interrupting the current conversation.
        When disabled (default), wake word detection is turned off during listening.

config USE_AUDIO_PROCESSOR
    bool "Enable Audio Noise Reduction"
    default y
    depends on (IDF_TARGET_ESP32S3 || IDF_TARGET_ESP32P4) && SPIRAM
    help
        Requires ESP32 S3 and PSRAM

config USE_DEVICE_AEC
    bool "Enable Device-Side AEC"
    default n
        depends on USE_AUDIO_PROCESSOR && (BOARD_TYPE_ESP_BOX_3 || BOARD_TYPE_ESP_BOX || BOARD_TYPE_ESP_BOX_LITE \
        || BOARD_TYPE_LICHUANG_DEV_S3 || BOARD_TYPE_RYMCU_BIGSMART || BOARD_TYPE_ESP_KORVO2_V3 || BOARD_TYPE_WAVESHARE_ESP32_S3_TOUCH_AMOLED_1_75|| BOARD_TYPE_WAVESHARE_ESP32_S3_TOUCH_AMOLED_1_75C || BOARD_TYPE_WAVESHARE_ESP32_S3_TOUCH_LCD_1_83\
        || BOARD_TYPE_WAVESHARE_ESP32_S3_TOUCH_AMOLED_2_06 || BOARD_TYPE_WAVESHARE_ESP32_S3_TOUCH_LCD_4B || BOARD_TYPE_WAVESHARE_ESP32_P4_WIFI6_TOUCH_LCD_4B || BOARD_TYPE_WAVESHARE_ESP32_P4_WIFI6_TOUCH_LCD_4_3 \
        || BOARD_TYPE_WAVESHARE_ESP32_P4_WIFI6_TOUCH_LCD_7B \
        || BOARD_TYPE_WAVESHARE_ESP32_P4_WIFI6_TOUCH_LCD_3_4C || BOARD_TYPE_WAVESHARE_ESP32_P4_WIFI6_TOUCH_LCD_4C || BOARD_TYPE_ESP_S3_LCD_EV_Board_2 || BOARD_TYPE_YUNLIAO_S3 \
        || BOARD_TYPE_WAVESHARE_ESP32_P4_WIFI6_TOUCH_LCD_7 || BOARD_TYPE_WAVESHARE_ESP32_P4_WIFI6_TOUCH_LCD_8 || BOARD_TYPE_WAVESHARE_ESP32_P4_WIFI6_TOUCH_LCD_10_1 \
        || BOARD_TYPE_ESP_VOCAT || BOARD_TYPE_WAVESHARE_ESP32_S3_TOUCH_LCD_3_49 || BOARD_TYPE_WAVESHARE_ESP32_S3_RLCD_4_2 || BOARD_TYPE_ZHENGCHEN_CAM || BOARD_TYPE_ZHENGCHEN_CAM_ML307 \
        || BOARD_TYPE_WAVESHARE_ESP32_S3_TOUCH_LCD_4_3C || BOARD_TYPE_WAVESHARE_ESP32_S3_TOUCH_LCD_1_54 || BOARD_TYPE_WAVESHARE_ESP32_S3_LCD_0_85 || BOARD_TYPE_AI_VOX3 || BOARD_TYPE_WAVESHARE_ESP32_S3_TOUCH_AMOLED_1_43C)
    help
        To work properly, device-side AEC requires a clean output reference path from the speaker signal and physical acoustic isolation between the microphone and speaker.

config USE_SERVER_AEC
    bool "Enable Server-Side AEC (Unstable)"
    default n
    depends on USE_AUDIO_PROCESSOR
    help
        To work perperly, server-side AEC requires server support

config USE_AUDIO_DEBUGGER
    bool "Enable Audio Debugger"
    default n
    help
        Enable audio debugger, send audio data through UDP to the host machine

config AUDIO_DEBUG_UDP_SERVER
    string "Audio Debug UDP Server Address"
    default "192.168.2.100:8000"
    depends on USE_AUDIO_DEBUGGER
    help
        UDP server address, format: IP:PORT, used to receive audio debugging data

config RECEIVE_CUSTOM_MESSAGE
    bool "Enable Custom Message Reception"
    default n
    help
        Enable custom message reception, allow the device to receive custom messages from the server (preferably through the MQTT protocol)


endmenu
```

## main/Kconfig.projbuild
```kconfig
menu "Smart-Puppy Configuration"
    menu "LCD"
        config LCD_WIDTH
        int "lcd width"
        default 320

        config LCD_HEIGHT
        int "lcd height"
        default 240
        
        config LCD_GPIO_SCK
        int "lcd gpio sck"
        default 2

        config LCD_GPIO_SDA
        int "lcd gpio sda"
        default 43

        config LCD_GPIO_DC
        int "lcd gpio dc"
        default 44

        config LCD_GPIO_CS
        int "lcd gpio cs"
        default 1

        config LCD_GPIO_RST
        int "lcd gpio rst"
        default 42

        config LCD_GPIO_BLK
        int "lcd gpio blk"
        default 41

        config TOUCH_KEY_GPIO
        int "touch key gpio"
        default 45

    endmenu

    menu "Audio"
        config AUDIO_INPUT_SAMPLE_RATE
        int "Audio input sample rate"
        default 16000

        config AUDIO_OUTPUT_SAMPLE_RATE
        int "Audio output sample rate"
        default 24000
        
        config AUDIO_I2S_GPIO_SPK_BCLK
        int "speaker io bclk"
        default 12

        config AUDIO_I2S_GPIO_SPK_WS
        int "speaker io ws"
        default 11

        config AUDIO_I2S_GPIO_SPK_DIN
        int "speaker io din"
        default 13

        config AUDIO_GPIO_PA_CTRL
        int "power amplifier io ctrl"
        default 14

        config AUDIO_I2S_GPIO_MIC_BCLK
        int "microphone io bclk"
        default 7

        config AUDIO_I2S_GPIO_MIC_WS
        int "microphone io ws"
        default 15

        config AUDIO_I2S_GPIO_MIC_DOUT
        int "microphone io dout"
        default 16

    endmenu

    menu "Battery Monitor"
        choice BAT_ADC_UNIT
            prompt "Battery ADC unit"
            default BAT_ADC_UNIT_1
            config BAT_ADC_UNIT_1
                bool "ADC Unit 1"
            config BAT_ADC_UNIT_2
                bool "ADC Unit 2"
        endchoice
      
        choice BAT_ADC_ATTEN
            prompt "Battery ADC attenuation"
            default BAT_ADC_ATTEN_DB_2_5
            config BAT_ADC_ATTEN_DB_0
                bool "0dB attenuation(100%)"
            config BAT_ADC_ATTEN_DB_2_5
                bool "2.5dB attenuation(75%)"
            config BAT_ADC_ATTEN_DB_6
                bool "6dB attenuation(50%)"
            config BAT_ADC_ATTEN_DB_12
                bool "12dB attenuation(25%)"
        endchoice
      
        config BAT_ADC_CHANNEL
                int "ADC CHANNEL 0~9"
                default 9

        config BAT_RESISTOR_UPPER
            int "Battery voltage divider upper resistor (ohms)"
            default 240000
            help
                Upper resistor value in the battery voltage divider circuit.

        config BAT_RESISTOR_LOWER
            int "Battery voltage divider lower resistor (ohms)"
            default 100000
            help
                Lower resistor value in the battery voltage divider circuit.

        config BAT_GPIO_CHARGING
            int "Battery charging detect GPIO"
            default 9
            help
                GPIO for detecting charging status (low = charging).
    endmenu

    menu "Accelerometer (SC7A20H)"
        config ACCEL_I2C_SDA_IO
            int "Accelerometer I2C SDA GPIO"
            default 47

        config ACCEL_I2C_SCL_IO
            int "Accelerometer I2C SCL GPIO"
            default 48

        config ACCEL_INT1_GPIO
            int "Accelerometer INT1 GPIO (-1 for NC)"
            default -1

        config ACCEL_INT2_GPIO
            int "Accelerometer INT2 GPIO"
            default 21
    endmenu

    menu "Servo"
        config SERVO_GPIO_LF
            int "Servo front left leg GPIO"
            default 17

        config SERVO_GPIO_LR
            int "Servo rear left leg GPIO"
            default 18

        config SERVO_GPIO_RF
            int "Servo front right leg GPIO"
            default 3

        config SERVO_GPIO_RR
            int "Servo rear right leg GPIO"
            default 46

        config SERVO_GPIO_TAIL
            int "Servo tail GPIO"
            default 38
    endmenu

    config SERVO_DEBUG
    bool "Open servo debug mode"
    default n

    menu "IOT ESP-NOW"
        config IOT_ESPNOW_PEER_MAC
            string "Peer MAC Address"
            default "FF:FF:FF:FF:FF:FF"
            help
                对端设备的 MAC 地址，格式为 "AA:BB:CC:DD:EE:FF"。

        config IOT_ESPNOW_CHANNEL
            int "ESP-NOW Channel (1-14)"
            range 1 14
            default 6
            help
                未连接 WiFi 时使用的 ESP-NOW 通信信道。
                若已连接 WiFi，则自动使用当前 WiFi 信道。
    endmenu

    menu "IOT Alibaba Cloud"
        config ALI_IOT_MQTT_URL
            string "Mqtt Url"
            default ""
            help
                阿里云IoT URL, 例如: mqtts://iot-xxx.mqtt.iothub.aliyuncs.com

        config ALI_IOT_PRODUCT_KEY
            string "Product Key"
            default ""
            help
                阿里云IoT产品 ProductKey。

        config ALI_IOT_DEVICE_NAME
            string "Device Name"
            default ""
            help
                阿里云IoT设备 DeviceName。

        config ALI_IOT_DEVICE_SECRET
            string "Device Secret"
            default ""
            help
                阿里云IoT设备 DeviceSecret。
    endmenu

endmenu
```
